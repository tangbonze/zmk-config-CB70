## config/boards/shields/cbkbd/Kconfig.shield
```kconfig
config SHIELD_MY_BOARD_LEFT
def_bool $(shields_list_contains,cbkbd_left)

config SHIELD_MY_BOARD_RIGHT
def_bool $(shields_list_contains,cbkbd_right)
```
